## applications/nrf_desktop/src/modules/Kconfig.ble_state
```kconfig
#
# Copyright (c) 2026 Nordic Semiconductor ASA
#
# SPDX-License-Identifier: LicenseRef-Nordic-5-Clause
#

config DESKTOP_BLE_STATE
	bool "Bluetooth LE state module"
	help
	  Enable the Bluetooth LE state module.
	  By default nRF Desktop uses the Bluetooth LE state module from Common Application
	  Framework (CAF).
	  An alternative, application-specific implementation is available which
	  is selected by enabling the CONFIG_DESKTOP_BLE_STATE_APP_SPECIFIC option.

config DESKTOP_BLE_STATE_CAF
	bool
	depends on DESKTOP_BLE_STATE
	depends on !DESKTOP_BLE_STATE_APP_SPECIFIC
	default y
	select CAF_BLE_STATE
	help
	  An alternative, application-specific implementation is available which
	  is selected by enabling the CONFIG_DESKTOP_BLE_STATE_APP_SPECIFIC option.

config DESKTOP_BLE_STATE_APP_SPECIFIC
	bool "Bluetooth LE state module (app-specific) [EXPERIMENTAL]"
	depends on DESKTOP_BLE_STATE
	depends on BT
	depends on BT_SMP
	select CAF_BLE_COMMON_EVENTS
	select CAF_BLE_STATE_SUPPORTED
	select EXPERIMENTAL
	help
	  Enable app-specific implementation of Bluetooth LE state module.
	  The module enables Bluetooth, handles Zephyr's connection callbacks,
	  propagates information about the connection state and parameters by
	  using Application Event Manager events and exchanges GATT MTU on GATT
	  Client.

if DESKTOP_BLE_STATE_APP_SPECIFIC

config DESKTOP_BLE_STATE_MODULE_SUSPEND_EVENTS
	bool "Module suspend/resume request events support"
	depends on CAF_MODULE_SUSPEND_EVENTS
	depends on DESKTOP_BT_PERIPHERAL
	default y
	help
	  Allow suspending and resuming the module at runtime using CAF module
	  suspend and resume request events.
	  Currently supported only for nRF Desktop peripheral configurations.

config DESKTOP_BLE_STATE_FREE_HW_RESOURCES_ON_SUSPEND
	bool "Free allocated HW resources on suspend to allow radio reuse"
	depends on DESKTOP_BLE_STATE_MODULE_SUSPEND_EVENTS
	depends on BT_LL_SOFTDEVICE
	select BT_UNINIT_MPSL_ON_DISABLE
	select MPSL_DYNAMIC_INTERRUPTS
	select DYNAMIC_DIRECT_INTERRUPTS
	select DYNAMIC_INTERRUPTS
	help
	  Free allocated hardware resources when module is suspended to allow
	  reusing radio e.g. to communicate over another wireless protocol.
	  The resources are freed on bt_disable call.

config DESKTOP_BLE_STATE_SECURITY_REQ
	bool "Request connection encryption (security level 2)"
	help
	  Automatically request connection encryption right after the connection is established.

config DESKTOP_BLE_STATE_PM
	bool "Bluetooth LE power manager integration"
	depends on CAF_POWER_MANAGER
	select CAF_KEEP_ALIVE_EVENTS
	default y
	help
	  This enables small module that keeps track on active connections.
	  The version of the module from the NCS CAF subsystem is reused.
	  If there is any active connection the power down modes would be limited to SUSPENDED.
	  Full POWER OFF mode would be only allowed if we have no active connection.

config DESKTOP_BLE_STATE_EXCHANGE_MTU
	bool "Exchange MTU"
	depends on BT_GATT_CLIENT
	default y
	help
	  Use the bt_gatt_exchange_mtu to set the MTU to the maximum possible size the buffers can
	  hold.

config DESKTOP_BLE_USE_LLPM
	bool "Low Latency Packet Mode (LLPM)"
	depends on (BT_CTLR_SDC_LLPM || !HAS_BT_CTLR)
	default y if HAS_BT_CTLR
	help
	  LLPM is a proprietary Bluetooth extension from Nordic Semiconductor. It is designed for
	  applications in which the interface response time is critical for the user. It introduces
	  the possibility to reduce the connection interval to 1 ms for one link. LLPM parameters
	  can be used for a given connection only if it's supported by both peripheral and central.

	  By default, if using the Bluetooth LE state module version from CAF
	  (CONFIG_DESKTOP_BLE_STATE_CAF enabled), the option is still present, but it's promptless
	  and mirrors the value of the CONFIG_CAF_BLE_USE_LLPM.
	  This is needed as the option is used also by application modules other than BLE state.

config DESKTOP_BLE_STATE_MAX_LOCAL_ID_BONDS
	int "Number of allowed bonds per Bluetooth local identity"
	depends on BT_PERIPHERAL
	range 1 BT_MAX_PAIRED
	default 1
	help
	  The available Bluetooth bonds are shared among Bluetooth local
	  identities. Limiting number of bonds allowed per local identity
	  prevents from situation where one local identity uses too many bonds.
	  In that case, other local identities may be unable to bond.

	  By default, if using the Bluetooth LE state module version from CAF
	  (CONFIG_DESKTOP_BLE_STATE_CAF enabled), the option is still present, but it's promptless
	  and mirrors the value of the CONFIG_CAF_BLE_STATE_MAX_LOCAL_ID_BONDS.
	  This is needed as the option is used also by application modules other than BLE state.

config DESKTOP_BLE_STATE_MAX_LOCAL_ID_BONDS
	depends on !BT_PERIPHERAL
	default 0

module = DESKTOP_BLE_STATE
module-str = Bluetooth LE state
source "subsys/logging/Kconfig.template.log_config"

endif # DESKTOP_BLE_STATE_APP_SPECIFIC

if DESKTOP_BLE_STATE_CAF

config DESKTOP_BLE_USE_LLPM
	bool
	default y if CAF_BLE_USE_LLPM
	help
	  If using the Bluetooth LE state module version from CAF
	  (CONFIG_DESKTOP_BLE_STATE_CAF enabled), the option is still present, but it's promptless
	  and mirrors the value of the CONFIG_CAF_BLE_USE_LLPM.
	  This is needed as the option is used also by application modules other than BLE state.

config DESKTOP_BLE_STATE_MAX_LOCAL_ID_BONDS
	int
	default CAF_BLE_STATE_MAX_LOCAL_ID_BONDS
	help
	  If using the Bluetooth LE state module version from CAF
	  (CONFIG_DESKTOP_BLE_STATE_CAF enabled), the option is still present, but it's promptless
	  and mirrors the value of the CONFIG_CAF_BLE_STATE_MAX_LOCAL_ID_BONDS.
	  This is needed as the option is used also by application modules other than BLE state.

config DESKTOP_BLE_STATE_MAX_LOCAL_ID_BONDS
	depends on !BT_PERIPHERAL
	default 0

endif # DESKTOP_BLE_STATE_CAF
```

## applications/nrf_desktop/src/modules/Kconfig.cpu_meas
```kconfig
#
# Copyright (c) 2020 Nordic Semiconductor
#
# SPDX-License-Identifier: LicenseRef-Nordic-5-Clause
#

menu "CPU load measurement"

config DESKTOP_CPU_MEAS_ENABLE
	bool "Enable measuring CPU load"
	select NRF_CPU_LOAD
	help
	  The CPU load is periodically measured. Results are sent using a
	  dedicated application event or logged using directly nRF Profiler API.

if DESKTOP_CPU_MEAS_ENABLE

config DESKTOP_CPU_MEAS_PERIOD
	int "Time between subsequent CPU load measurements [ms]"
	default 1000
	range 1 4294000
	help
	  The CPU load is measured periodically by a delayed work. Application
	  module resets measurement every time the result is provided.

	  According to CPU load subsystem documentation, measurement must be
	  reset at least every 4294 seconds. Otherwise results are invalid.

config DESKTOP_CPU_MEAS_RESULT_NRF_PROFILER
	bool "Provide results through nRF Profiler event"
	depends on NRF_PROFILER
	default y
	help
	  nRF Profiler API is used directly to emit the CPU load with minimal
	  impact on performance.

config DESKTOP_CPU_MEAS_RESULT_EVENT
	bool "Provide results through a CPU load application event"
	select DESKTOP_CPU_LOAD_EVENT
	default y if !DESKTOP_CPU_MEAS_RESULT_NRF_PROFILER
	help
	  A dedicated Application Event Manager event (cpu_load_event) is
	  submitted to inform about the CPU load.

	  The option is disabled in case results are provided through nRF
	  Profiler event to avoid impacting the CPU load.

module = DESKTOP_CPU_MEAS
module-str = CPU meas
source "subsys/logging/Kconfig.template.log_config"

endif

endmenu
```

## applications/nrf_desktop/src/modules/Kconfig.hotfixes
```kconfig
#
# Copyright (c) 2019 Nordic Semiconductor
#
# SPDX-License-Identifier: LicenseRef-Nordic-5-Clause
#

menu "Hotfix set"

config DESKTOP_CONSTLAT_ENABLE
	bool "Constant latency interrupts"
	select NRFX_POWER
	help
	  When enabled, the SoC uses configuration for constant latency
	  interrupts. This reduces interrupt propagation time but increases
	  power consumption.

config DESKTOP_CONSTLAT_DISABLE_ON_STANDBY
	bool "Disable constant latency interrupts on standby"
	depends on CAF_PM_EVENTS
	depends on DESKTOP_CONSTLAT_ENABLE
	help
	  When enabled constant latency interrupts will be disabled when
	  the devices switches to standby.

endmenu
```

## applications/nrf_desktop/src/modules/Kconfig.ram_pwrdn
```kconfig
#
# Copyright (c) 2026 Nordic Semiconductor ASA
#
# SPDX-License-Identifier: LicenseRef-Nordic-5-Clause
#

config DESKTOP_RAM_PWRDN_SOC
	def_bool SOC_NRF54L05_CPUAPP || SOC_NRF54L10_CPUAPP || SOC_NRF54L15_CPUAPP || \
		     SOC_NRF54LC10A_CPUAPP || SOC_NRF54LM20A_CPUAPP || SOC_NRF54LM20B_CPUAPP

config DESKTOP_RAM_PWRDN
	bool "Power down unused SRAM on supported nRF54L application cores"
	depends on DESKTOP_RAM_PWRDN_SOC
	select RAM_POWER_DOWN_LIBRARY
	help
	  Gate off unused SRAM after the main module is ready.

	  Uses RAM_POWER_DOWN_LIBRARY (complete 32 KiB sections on nRF54L only).
	  Within chosen zephyr,sram, gates the unused tail from the linked image
	  RAM end through the node end; RAM load builds may
	  also gate cpuapp_sram_unused_ram_region and the tail of
	  cpuapp_sram_mcuboot_ram_region above the linked RAM end. Savings
	  require RAM layout alignment with section boundaries.

	  Supported on nRF54L05/10/15, nRF54LC10, and nRF54LM20. nRF54LS05 is
	  excluded until the library defines RAM banks for that device.

if DESKTOP_RAM_PWRDN

module = DESKTOP_RAM_PWRDN
module-str = nRF Desktop RAM power down
source "subsys/logging/Kconfig.template.log_config"

endif
```

## subsys/caf/Kconfig
```kconfig
#
# Copyright (c) 2026 Nordic Semiconductor ASA
#
# SPDX-License-Identifier: LicenseRef-Nordic-5-Clause
#

menu "HID add-on CAF extensions"
	depends on CAF

config CAF_EXTENSION
	bool "HID add-on CAF extensions"
	default y
	help
	  CAF extensions provided by the HID add-on.

	  The HID Add-on temporarily extends CAF until these features are
	  available in the used nRF Connect SDK release. These features are already
	  available in nRF Connect SDK main and ported here for early access.

	  The add-on also provides the CAF Buttons ISR module that
	  reduces click latency for gaming-grade HID devices.

if CAF_EXTENSION

rsource "events/Kconfig"
rsource "modules/Kconfig"

endif # CAF_EXTENSION

endmenu
```

## subsys/caf/events/Kconfig
```kconfig
#
# Copyright (c) 2026 Nordic Semiconductor ASA
#
# SPDX-License-Identifier: LicenseRef-Nordic-5-Clause
#

menu "Event options"

config CAF_BLE_COMMON_EVENTS_EXTENSION
	bool "BLE common event extensions"
	depends on CAF_BLE_COMMON_EVENTS
	default y
	help
	  Enable HID add-on extensions for CAF BLE common events not yet
	  available in the used NCS release.

config CAF_BLE_SCI_CONN_RATE_EVENTS
	bool "BLE SCI connection rate events"
	depends on CAF_BLE_COMMON_EVENTS_EXTENSION
	depends on CAF_BLE_STATE_EXTENSION
	depends on BT_SHORTER_CONNECTION_INTERVALS
	default y
	help
	  Enable support for BLE SCI connection rate events.

	  Provided by the HID add-on until available in the used NCS release.

config CAF_INIT_LOG_BLE_SCI_CONN_RATE_EVENTS
	bool "Log BLE peer connection rate events"
	depends on CAF_BLE_SCI_CONN_RATE_EVENTS
	depends on LOG
	default y

endmenu
```

## subsys/caf/modules/Kconfig.ble_state_extension
```kconfig
#
# Copyright (c) 2026 Nordic Semiconductor ASA
#
# SPDX-License-Identifier: LicenseRef-Nordic-5-Clause
#

config CAF_BLE_STATE_EXTENSION
	bool "CAF BLE state extension module"
	depends on CAF_BLE_STATE
	default y
	help
	  Register additional Bluetooth connection callbacks and submit CAF
	  extension events not yet available in the used NCS release.

if CAF_BLE_STATE_EXTENSION

module = CAF_BLE_STATE_EXTENSION
module-str = CAF BLE state extension
source "subsys/logging/Kconfig.template.log_config"

endif # CAF_BLE_STATE_EXTENSION
```

## subsys/caf/modules/Kconfig.buttons_direct_isr
```kconfig
#
# Copyright (c) 2026 Nordic Semiconductor ASA
#
# SPDX-License-Identifier: LicenseRef-Nordic-5-Clause
#

menuconfig CAF_BUTTONS_ISR
	bool "Buttons module (low button press latency)"
	depends on !CAF_BUTTONS
	select CAF_BUTTON_EVENTS
	help
	  Alternative implementation of CAF Buttons module from the NCS.
	  Emit button press and release events with minimal latency.
	  Debouncing is applied after press and release detection.
	  Supports only directly connected buttons.
	  Does not support keyboard matrix.

if CAF_BUTTONS_ISR

config CAF_BUTTONS_DEF_PATH
	string "Configuration file"
	default "buttons_def.h"
	help
	  Location of configuration file for buttons module.

config CAF_BUTTONS_PM_EVENTS
	bool "Power management events support"
	depends on CAF_PM_EVENTS
	default y

config CAF_BUTTONS_PM_KEEP_ALIVE
	bool "Generate keep alive power event on button press"
	depends on CAF_POWER_MANAGER
	select CAF_KEEP_ALIVE_EVENTS
	default y
	help
	  Every button press would generate keep alive event.

config CAF_BUTTONS_DEBOUNCE_INTERVAL
	int "Interval used to debounce button release in ms"
	default 2
	help
	  Does not affect button presses.

config CAF_BUTTONS_POLARITY_INVERSED
	bool "Inverse buttons polarity"
	help
	  When this option is enabled, button is pressed when the GPIO state
	  is low.

config CAF_BUTTONS_WQ
	bool "Use dedicated workqueue for button debouncing works"
	help
	  Using a separate context might allow to avoid interfering with the
	  system workqueue. Useful for example if button_event triggers start
	  of critical path that executes in the system workqueue context.

	  If the feature is enabled, the dedicated workqueue context is used
	  also for the error work.

	  The feature can be disabled to reduce memory footprint. Then the
	  system workqueue is used as execution context for works handling
	  button debouncing.

if CAF_BUTTONS_WQ

config CAF_BUTTONS_WQ_STACK_SIZE
	int "Stack size of the dedicated workqueue"
	default 1024
	help
	  In most of the cases, application can rely on the default stack size.
	  The option can be used to finetune the stack size if needed.

config CAF_BUTTONS_WQ_PRIO
	int "Priority of the dedicated workqueue"
	default -1
	range -256 -1
	help
	  The current implementation supports only cooperative priorities.

endif # CAF_BUTTONS_WQ

module = CAF_BUTTONS
module-str = caf module buttons
source "subsys/logging/Kconfig.template.log_config"

endif # CAF_BUTTONS_ISR
```

## west.yml
```yaml
#
# Copyright (c) 2026 Nordic Semiconductor ASA
#
# SPDX-License-Identifier: LicenseRef-Nordic-5-Clause
#

manifest:
  remotes:
    - name: ncs
      url-base: https://github.com/nrfconnect

  projects:
    - name: nrf
      remote: ncs
      repo-path: sdk-nrf
      revision: d8ff0f8939d38da272ffa71cf3d70d8e8f054801
      import: true

  self:
    path: hid
```
