## applications/nrf_desktop/sample.yaml
```yaml
sample:
  name: nRF Desktop - HID reference design
  description: The nRF Desktop is an HID reference design application. It can be configured
    to function as a mouse, keyboard or USB dongle bridging radio connected HID peripheral.
common:
  sysbuild: true
  tags:
    - ci_build
    - sysbuild
    - ci_applications_nrf_desktop
tests:
  ncs_hid.applications.nrf_desktop.zdebug:
    harness: console
    harness_config: &ble_peripheral_harness_config
      type: multi_line
      ordered: false
      regex:
        - "app_event_manager: e:module_state_event module:main state:READY"
        - "ble_state: Bluetooth initialized"
        - "settings_loader: Settings loaded"
        - "ble_bond: Selected Bluetooth LE peers"
        - "ble_adv: Advertising started"
    platform_allow:
      - nrf54l15dk/nrf54l05/cpuapp
      - nrf54l15dk/nrf54l10/cpuapp
      - nrf54l15dk/nrf54l15/cpuapp
      - nrf54lm20dk/nrf54lm20a/cpuapp
      - nrf54lm20dk/nrf54lm20b/cpuapp
      - nrf54ls05dk/nrf54ls05a/cpuapp
      - nrf54ls05dk/nrf54ls05b/cpuapp
      - nrf54lc10dk/nrf54lc10a/cpuapp
    integration_platforms:
      - nrf54l15dk/nrf54l05/cpuapp
      - nrf54l15dk/nrf54l10/cpuapp
      - nrf54l15dk/nrf54l15/cpuapp
      - nrf54lm20dk/nrf54lm20b/cpuapp
      - nrf54ls05dk/nrf54ls05a/cpuapp
      - nrf54ls05dk/nrf54ls05b/cpuapp
      - nrf54lc10dk/nrf54lc10a/cpuapp
  ncs_hid.applications.nrf_desktop.zdebug_fast_pair.gmouse:
    harness: console
    harness_config: *ble_peripheral_harness_config
    platform_allow:
      - nrf54l15dk/nrf54l10/cpuapp
      - nrf54l15dk/nrf54l15/cpuapp
    integration_platforms:
      - nrf54l15dk/nrf54l10/cpuapp
      - nrf54l15dk/nrf54l15/cpuapp
    extra_args:
      - FILE_SUFFIX=fast_pair
  ncs_hid.applications.nrf_desktop.zdebug_hid_sci:
    harness: console
    harness_config: *ble_peripheral_harness_config
    platform_allow:
      - nrf54l15dk/nrf54l05/cpuapp
      - nrf54l15dk/nrf54l10/cpuapp
      - nrf54l15dk/nrf54l15/cpuapp
      - nrf54lm20dk/nrf54lm20a/cpuapp
      - nrf54lm20dk/nrf54lm20b/cpuapp
      - nrf54ls05dk/nrf54ls05a/cpuapp
      - nrf54ls05dk/nrf54ls05b/cpuapp
    integration_platforms:
      - nrf54l15dk/nrf54l05/cpuapp
      - nrf54l15dk/nrf54l15/cpuapp
      - nrf54lm20dk/nrf54lm20a/cpuapp
      - nrf54lm20dk/nrf54lm20b/cpuapp
      - nrf54ls05dk/nrf54ls05a/cpuapp
    extra_args: FILE_SUFFIX=hid_sci
  ncs_hid.applications.nrf_desktop.zrelease_hid_sci:
    build_only: true
    platform_allow:
      - nrf54l15dk/nrf54l05/cpuapp
      - nrf54l15dk/nrf54l10/cpuapp
      - nrf54l15dk/nrf54l15/cpuapp
      - nrf54lm20dk/nrf54lm20a/cpuapp
      - nrf54lm20dk/nrf54lm20b/cpuapp
      - nrf54ls05dk/nrf54ls05a/cpuapp
      - nrf54ls05dk/nrf54ls05b/cpuapp
    integration_platforms:
      - nrf54l15dk/nrf54l05/cpuapp
      - nrf54l15dk/nrf54l15/cpuapp
      - nrf54lm20dk/nrf54lm20a/cpuapp
      - nrf54lm20dk/nrf54lm20b/cpuapp
      - nrf54ls05dk/nrf54ls05a/cpuapp
    extra_args: FILE_SUFFIX=release_hid_sci
  ncs_hid.applications.nrf_desktop.zdebug_dongle_4llpmconn:
    harness: console
    harness_config: &ble_dongle_harness_config
      type: multi_line
      ordered: false
      regex:
        - "app_event_manager: e:module_state_event module:main state:READY"
        - "ble_state: Bluetooth initialized"
        - "settings_loader: Settings loaded"
        - "ble_bond: Selected Bluetooth LE peers"
        - "ble_scan: Scan started"
    platform_allow:
      - nrf54lm20dk/nrf54lm20a/cpuapp
      - nrf54lm20dk/nrf54lm20b/cpuapp
    integration_platforms:
      - nrf54lm20dk/nrf54lm20b/cpuapp
    extra_args: FILE_SUFFIX=dongle_4llpmconn
  ncs_hid.applications.nrf_desktop.zdebug_dongle:
    harness: console
    harness_config: *ble_dongle_harness_config
    platform_allow:
      - nrf54lm20dk/nrf54lm20a/cpuapp
      - nrf54lm20dk/nrf54lm20b/cpuapp
    integration_platforms:
      - nrf54lm20dk/nrf54lm20b/cpuapp
    extra_args: FILE_SUFFIX=dongle
  ncs_hid.applications.nrf_desktop.zrelease_dongle:
    build_only: true
    platform_allow:
      - nrf54lm20dk/nrf54lm20a/cpuapp
      - nrf54lm20dk/nrf54lm20b/cpuapp
    integration_platforms:
      - nrf54lm20dk/nrf54lm20b/cpuapp
    extra_args: FILE_SUFFIX=release_dongle
  ncs_hid.applications.nrf_desktop.zdebug_hid_sci_dongle:
    harness: console
    harness_config: *ble_dongle_harness_config
    platform_allow:
      - nrf54lm20dk/nrf54lm20a/cpuapp
      - nrf54lm20dk/nrf54lm20b/cpuapp
    integration_platforms:
      - nrf54lm20dk/nrf54lm20b/cpuapp
    extra_args: FILE_SUFFIX=hid_sci_dongle
  ncs_hid.applications.nrf_desktop.zrelease_hid_sci_dongle:
    build_only: true
    platform_allow:
      - nrf54lm20dk/nrf54lm20a/cpuapp
      - nrf54lm20dk/nrf54lm20b/cpuapp
    integration_platforms:
      - nrf54lm20dk/nrf54lm20b/cpuapp
    extra_args: FILE_SUFFIX=release_hid_sci_dongle
  ncs_hid.applications.nrf_desktop.zdebug_hid_sci_keyboard:
    harness: console
    harness_config: *ble_peripheral_harness_config
    platform_allow:
      - nrf54l15dk/nrf54l05/cpuapp
      - nrf54l15dk/nrf54l10/cpuapp
      - nrf54l15dk/nrf54l15/cpuapp
      - nrf54ls05dk/nrf54ls05a/cpuapp
      - nrf54ls05dk/nrf54ls05b/cpuapp
    integration_platforms:
      - nrf54l15dk/nrf54l05/cpuapp
      - nrf54l15dk/nrf54l15/cpuapp
      - nrf54ls05dk/nrf54ls05a/cpuapp
    extra_args: FILE_SUFFIX=hid_sci_keyboard
  ncs_hid.applications.nrf_desktop.zrelease_hid_sci_keyboard:
    build_only: true
    platform_allow:
      - nrf54l15dk/nrf54l05/cpuapp
      - nrf54l15dk/nrf54l10/cpuapp
      - nrf54l15dk/nrf54l15/cpuapp
      - nrf54ls05dk/nrf54ls05a/cpuapp
      - nrf54ls05dk/nrf54ls05b/cpuapp
    integration_platforms:
      - nrf54l15dk/nrf54l05/cpuapp
      - nrf54l15dk/nrf54l15/cpuapp
      - nrf54ls05dk/nrf54ls05a/cpuapp
    extra_args: FILE_SUFFIX=release_hid_sci_keyboard
  # The configuration below is used to measure click latency.
  # It modifies parameters for the HID SCI FAST mode: maximum latency is set to 0
  # and the maximum subrate is set to 1.
  # This allows bringing the overall click latency as low as possible.
  # Lower latency comes at the cost of higher power consumption.
  ncs_hid.applications.nrf_desktop.zrelease_hid_sci_mouse_click:
    build_only: true
    platform_allow:
      - nrf54l15dk/nrf54l15/cpuapp
      - nrf54lm20dk/nrf54lm20a/cpuapp
      - nrf54lm20dk/nrf54lm20b/cpuapp
      - nrf54ls05dk/nrf54ls05b/cpuapp
    integration_platforms:
      - nrf54l15dk/nrf54l15/cpuapp
      - nrf54lm20dk/nrf54lm20a/cpuapp
      - nrf54lm20dk/nrf54lm20b/cpuapp
      - nrf54ls05dk/nrf54ls05b/cpuapp
    extra_args: FILE_SUFFIX=release_hid_sci
    extra_configs:
      - CONFIG_DESKTOP_MOTION_NONE=y
      - CONFIG_DESKTOP_HID_KEYMAP_DEF_PATH="hid_keymap_def_mouse_click.h"
      - CONFIG_BT_HIDS_SCI_FAST_MAX_LATENCY=0
      - CONFIG_BT_HIDS_SCI_FAST_SUBRATE_MAX=1
      - CONFIG_BT_HIDS_SCI_FAST_CONTINUATION_NUM=0
  ncs_hid.applications.nrf_desktop.zdebug_keyboard:
    harness: console
    harness_config: *ble_peripheral_harness_config
    platform_allow:
      - nrf54l15dk/nrf54l10/cpuapp
      - nrf54l15dk/nrf54l15/cpuapp
      - nrf54ls05dk/nrf54ls05a/cpuapp
      - nrf54ls05dk/nrf54ls05b/cpuapp
    integration_platforms:
      - nrf54l15dk/nrf54l10/cpuapp
      - nrf54l15dk/nrf54l15/cpuapp
      - nrf54ls05dk/nrf54ls05a/cpuapp
      - nrf54ls05dk/nrf54ls05b/cpuapp
    extra_args: FILE_SUFFIX=keyboard
  ncs_hid.applications.nrf_desktop.zrelease_keyboard:
    build_only: true
    platform_allow:
      - nrf54l15dk/nrf54l05/cpuapp
      - nrf54ls05dk/nrf54ls05a/cpuapp
      - nrf54ls05dk/nrf54ls05b/cpuapp
    integration_platforms:
      - nrf54l15dk/nrf54l05/cpuapp
      - nrf54ls05dk/nrf54ls05a/cpuapp
      - nrf54ls05dk/nrf54ls05b/cpuapp
    extra_args: FILE_SUFFIX=release_keyboard
  ncs_hid.applications.nrf_desktop.zrelease:
    build_only: true
    platform_allow:
      - nrf54l15dk/nrf54l05/cpuapp
      - nrf54l15dk/nrf54l10/cpuapp
      - nrf54l15dk/nrf54l15/cpuapp
      - nrf54lm20dk/nrf54lm20a/cpuapp
      - nrf54lm20dk/nrf54lm20b/cpuapp
      - nrf54ls05dk/nrf54ls05a/cpuapp
      - nrf54ls05dk/nrf54ls05b/cpuapp
      - nrf54lc10dk/nrf54lc10a/cpuapp
    integration_platforms:
      - nrf54l15dk/nrf54l15/cpuapp
      - nrf54lm20dk/nrf54lm20b/cpuapp
      - nrf54ls05dk/nrf54ls05a/cpuapp
      - nrf54ls05dk/nrf54ls05b/cpuapp
      - nrf54lc10dk/nrf54lc10a/cpuapp
    extra_args: FILE_SUFFIX=release
  ncs_hid.applications.nrf_desktop.zrelease_fast_pair.gmouse:
    build_only: true
    platform_allow:
      - nrf54l15dk/nrf54l05/cpuapp
      - nrf54ls05dk/nrf54ls05a/cpuapp
      - nrf54ls05dk/nrf54ls05b/cpuapp
    integration_platforms:
      - nrf54l15dk/nrf54l05/cpuapp
      - nrf54ls05dk/nrf54ls05a/cpuapp
    extra_args:
      - FILE_SUFFIX=release_fast_pair
  ncs_hid.applications.nrf_desktop.zrelease_dongle_4llpmconn:
    build_only: true
    platform_allow:
      - nrf54lm20dk/nrf54lm20a/cpuapp
      - nrf54lm20dk/nrf54lm20b/cpuapp
    integration_platforms:
      - nrf54lm20dk/nrf54lm20b/cpuapp
    extra_args: FILE_SUFFIX=release_dongle_4llpmconn
  ncs_hid.applications.nrf_desktop.zdebug.llvm:
    harness: console
    harness_config: *ble_peripheral_harness_config
    toolchain_allow: llvm
    integration_platforms:
      - nrf54lm20dk/nrf54lm20b/cpuapp
    platform_allow:
      - nrf54lm20dk/nrf54lm20a/cpuapp
      - nrf54lm20dk/nrf54lm20b/cpuapp
    extra_args: FILE_SUFFIX=llvm
  ncs_hid.applications.nrf_desktop.zdebug_ram_load:
    harness: console
    harness_config: *ble_peripheral_harness_config
    platform_allow:
      - nrf54lm20dk/nrf54lm20a/cpuapp
      - nrf54lm20dk/nrf54lm20b/cpuapp
    integration_platforms:
      - nrf54lm20dk/nrf54lm20b/cpuapp
    extra_args: FILE_SUFFIX=ram_load
  ncs_hid.applications.nrf_desktop.zrelease_ram_load:
    build_only: true
    platform_allow:
      - nrf54lm20dk/nrf54lm20a/cpuapp
      - nrf54lm20dk/nrf54lm20b/cpuapp
    integration_platforms:
      - nrf54lm20dk/nrf54lm20b/cpuapp
    extra_args: FILE_SUFFIX=release_ram_load
```

## applications/nrf_desktop/src/events/Kconfig
```kconfig
#
# Copyright (c) 2025 Nordic Semiconductor ASA
#
# SPDX-License-Identifier: LicenseRef-Nordic-5-Clause
#

menu "Application events"

config DESKTOP_HID_REPORT_PROVIDER_EVENT
	bool "HID report provider events"
	help
	  Enable HID report provider events in nRF Desktop application.

config DESKTOP_HOGP_EVENTS
	bool "HOGP events"
	help
	  Enable HOGP events in nRF Desktop application.

config DESKTOP_CPU_LOAD_EVENT
	bool "CPU load event"
	help
	  The CPU load event contains CPU load in 0,001% units.

rsource "Kconfig.log"

endmenu
```
